// SPDX-License-Identifier: GPL-2.0-only OR MIT
/*
 * Copyright (C) 2026 PHYTEC America, LLC
 * Author: Garrett Giordano <ggiordano@phytec.com>
 */

/dts-v1/;
/plugin/;

&reserved_memory {
	#address-cells = <2>;
	#size-cells = <2>;

	edgeai_memory_region: edgeai-dma-memory@a1000000 {
		compatible = "shared-dma-pool";
		reg = <0x00 0xa1000000 0x00 0x02000000>;
		no-map;
	};

	edgeai_shared_region: edgeai_shared-memories {
		compatible = "dma-heap-carveout";
		reg = <0x00 0xa3000000 0x00 0x0ac00000>;
	};

	edgeai_core_heaps: edgeai-core-heap-memory@adc00000 {
		compatible = "shared-dma-pool";
		reg = <0x00 0xadc00000 0x00 0x12400000>;
		no-map;
	};
};
