// SPDX-License-Identifier: GPL-2.0-only OR MIT
/*
 * Copyright (C) 2025 PHYTEC America, LLC
 * Author: Nathan Morrisson <nmorrisson@phytec.com>
 */

/dts-v1/;
/plugin/;

#include "k3-pinctrl.h"

&main_pmx0 {
	main_spi0_pins_default: main-spi0-default-pins {
		pinctrl-single,pins = <
			J722S_IOPAD(0x01bc, PIN_INPUT, 0)	/* (D20) SPI0_CLK */
			J722S_IOPAD(0x01b4, PIN_OUTPUT, 0)	/* (B20) SPI0_CS0 */
			J722S_IOPAD(0x01c0, PIN_OUTPUT, 0)	/* (E19) SPI0_D0 */
			J722S_IOPAD(0x01c4, PIN_INPUT, 0)	/* (E20) SPI0_D1 */
		>;
	};
};

&main_spi0 {
	#address-cells = <1>;
	#size-cells = <0>;

	pinctrl-names = "default";
	pinctrl-0 = <&main_spi0_pins_default>;
	ti,pindir-d0-out-d1-in;
	status = "okay";

	spidev@0 {
		reg = <0>;

		spi-max-frequency = <24000000>;
		compatible = "rohm,dh2228fv";
	};
};
