## Documentation/devicetree/bindings/media/i2c/onsemi,ar0144.yaml
```yaml
# SPDX-License-Identifier: (GPL-2.0-only OR BSD-2-Clause)
%YAML 1.2
---
$id: http://devicetree.org/schemas/media/i2c/onsemi,ar0144.yaml#
$schema: http://devicetree.org/meta-schemas/core.yaml#

title: OnSemi CMOS Digital Image Sensor

maintainers:
  - Stefan Riedmueller <s.riedmueller@phytec.de>

description: |
  The OnSemiconductor AR0144 is a 1/4-inch 1.0 Mp CMOS digital image sensor
  with an active-pixel array of 1280H x 800V. It features a 1 or 2 lane
  MIPI-CSI2 interface or a parallel interface. It is programmable through a
  simple two-wire serial interface.

  The AR0234CS is a 1/2.6−inch 2Mp CMOS digital image sensor with an
  active−pixel array of 1920H x 1200V. It features a 1, 2 or 4 lane MIPI-CSI2
  interface as well as a parallel interface. It is programmable through a
  simple two-wire serial interface.

properties:
  compatible:
    enum:
      - onsemi,ar0144
      - onsemi,ar0144c
      - onsemi,ar0144m
      - onsemi,ar0234
      - onsemi,ar0234c
      - onsemi,ar0234m

  reg:
    description: I2C device address
    maxItems: 1

  clocks:
    maxItems: 1

  clock-names:
    const: ext

  reset-gpios:
    maxItems: 1
    description: Chip reset GPIO

  onsemi,extra-wait-after-reset:
    description: Extra wait (in microseconds) after asserting reset
    $ref: /schemas/types.yaml#/definitions/uint32
    minimum: 0
    maximum: 200000
    default: 0

  port:
    $ref: /schemas/graph.yaml#/$defs/port-base
    additionalProperties: false

    properties:
      endpoint:
        $ref: /schemas/media/video-interfaces.yaml#
        unevaluatedProperties: false

        properties:
          bus-type:
            oneOf:
              - const: 4 # MIPI CSI-2 D-PHY
              - const: 5 # Parallel

          onsemi,slew-rate-dat:
            description: Data lines slew rate
            $ref: /schemas/types.yaml#/definitions/uint32
            minimum: 0
            maximum: 7
            default: 0

          onsemi,slew-rate-clk:
            description: Clock line slew rate
            $ref: /schemas/types.yaml#/definitions/uint32
            minimum: 0
            maximum: 7
            default: 0

          onsemi,t-hs-prep:
            description: MIPI Ths_prep value
            $ref: /schemas/types.yaml#/definitions/uint32
            minimum: 0
            maximum: 15
            default: 2

          onsemi,t-hs-zero:
            description: MIPI Ths_zero value
            $ref: /schemas/types.yaml#/definitions/uint32
            minimum: 0
            maximum: 15
            default: 6

          onsemi,t-hs-trail:
            description: MIPI Ths_trail value
            $ref: /schemas/types.yaml#/definitions/uint32
            minimum: 0
            maximum: 15
            default: 6

          onsemi,t-clk-trail:
            description: MIPI Tclk_trail value
            $ref: /schemas/types.yaml#/definitions/uint32
            minimum: 0
            maximum: 15
            default: 5

          onsemi,t-clk-prep:
            description: MIPI Tclk_prep value
            $ref: /schemas/types.yaml#/definitions/uint32
            minimum: 0
            maximum: 15
            default: 1

          onsemi,t-hs-exit:
            description: MIPI Ths_exit value
            $ref: /schemas/types.yaml#/definitions/uint32
            minimum: 0
            maximum: 63
            default: 4

          onsemi,t-clk-zero:
            description: MIPI Tclk_zero value
            $ref: /schemas/types.yaml#/definitions/uint32
            minimum: 0
            maximum: 63
            default: 14

          onsemi,t-bgap:
            description: MIPI Tbgap value
            $ref: /schemas/types.yaml#/definitions/uint32
            minimum: 0
            maximum: 15
            default: 2

          onsemi,t-clk-pre:
            description: MIPI Tclk_pre value
            $ref: /schemas/types.yaml#/definitions/uint32
            minimum: 0
            maximum: 63
            default: 1

          onsemi,t-clk-post:
            description: MIPI Tclk_post value
            $ref: /schemas/types.yaml#/definitions/uint32
            minimum: 0
            maximum: 63
            default: 7

          onsemi,t-lpx:
            description: MIPI Tlpx value
            $ref: /schemas/types.yaml#/definitions/uint32
            minimum: 0
            maximum: 63
            default: 2

          onsemi,t-wakeup:
            description: MIPI Twakeup value
            $ref: /schemas/types.yaml#/definitions/uint32
            minimum: 0
            maximum: 127
            default: 5

          onsemi,t-init:
            description: MIPI Tinit value
            $ref: /schemas/types.yaml#/definitions/uint32
            minimum: 0
            maximum: 127
            default: 4

          onsemi,cont-tx-clk:
            description: MIPI continuous TX clock
            type: boolean

          onsemi,heavy-lp-load:
            description: MIPI set heavy LP load
            type: boolean

          link-frequencies:
            description: |
              Maximum link frequency of the interface.
            maxItems: 1

          data-lanes:
            oneOf:
              - items:
                - const: 1
                - const: 2
              - items:
                - const: 1

          clock-lanes: true
          clock-noncontinuous: true

        allOf:
          - if:
              properties:
                bus-type:
                  const: 4 # MIPI CSI-2 D-PHY

            then:
              properties:
                onsemi,slew-rate-dat: false
                onsemi,slew-rate-clk: false

              required:
                - data-lanes
                - clock-lanes

          - if:
              properties:
                bus-type:
                  const: 5 # Parallel

            then:
              properties:
                data-lanes: false
                clock-lanes: false
                clock-noncontinuous: false
                onsemi,t-hs-prep: false
                onsemi,t-hs-zero: false
                onsemi,t-hs-trail: false
                onsemi,t-clk-trail: false
                onsemi,t-clk-prep: false
                onsemi,t-hs-exit: false
                onsemi,t-clk-zero: false
                onsemi,t-bgap: false
                onsemi,t-clk-pre: false
                onsemi,t-clk-post: false
                onsemi,t-lpx: false
                onsemi,t-wakeup: false
                onsemi,t-init: false
                onsemi,cont-tx-clk: false
                onsemi,heavy-lp-load: false

        required:
          - bus-type
          - link-frequencies


allOf:
  - if:
      properties:
        compatible:
          enum:
            - onsemi,ar0234
            - onsemi,ar0234m
            - onsemi,ar0234c
        bus-type:
          const: 4 # MIPI CSI-2 D-PHY

    then:
      - if:
          properties:
            port:
              endpoint:
                properties:
                  bus-type:
                    const: 4 # MIPI CSI-2 D-PHY

        then:
          properties:
            port:
              endpoint:
                properties:
                  data-lanes:
                    oneOf:
                      - items:
                        - const: 1
                        - const: 2
                        - const: 3
                        - const: 4
                      - items:
                        - const: 1
                        - const: 2
                      - items:
                        - const: 1

                  link-frequencies:
                    maximum: 350000000

                  onsemi,t-hs-prep:
                    default: 5

                  onsemi,t-hs-zero: false

                  onsemi,t-hs-trail:
                    maximum: 31
                    default: 9

                  onsemi,t-clk-trail:
                    maximum: 31
                    default: 8

                  onsemi,t-clk-prep:
                    default: 8

                  onsemi,t-hs-exit:
                    default: 10

                  onsemi,t-clk-zero:
                    default: 24

                  onsemi,t-bgap:
                    default: 9

                  onsemi,t-clk-post:
                    default: 11

                  onsemi,t-lpx:
                    default: 6

                  onsemi,t-wakeup:
                    default: 12

                  onsemi,t-init:
                    default: 10

                  onsemi,cont-tx-clk:
                    default: true

        else:
          properties:
            port:
              endpoint:
                properties:
                  link-frequencies:
                    maximum: 90000000


required:
  - compatible
  - reg
  - clocks
  - clock-names
  - port

additionalProperties: false

examples:
  - |
    i2c0 {
        #address-cells = <1>;
        #size-cells = <0>;

        camera@10 {
            compatible = "onsemi,ar0144";
            reg = <0x10>;
            reset-gpios = <&gpio_sensor 0 0>;

            clocks = <&sensor_clk>;
            clock-names = "ext";

            port {
                camera_1: endpoint {
                    bus-type = <4>; /* MIPI CSI-2 D-PHY */
                    link-frequencies = /bits/ 64 <384000000>;
                    data-lanes = <1 2>;
                    clock-lanes = <0>;
                    clock-noncontinuous = <1>;
                };
            };
        };
    };

    i2c1 {
        #address-cells = <1>;
        #size-cells = <0>;

        camera@10 {
            compatible = "onsemi,ar0144";
            reg = <0x10>;
            reset-gpios = <&gpio_sensor 0 0>;

            clocks = <&sensor_clk>;
            clock-names = "ext";

            port {
                camera_1: endpoint {
                    bus-type = <5>; /* Parallel */
                    link-frequencies = /bits/ 64 <74250000>;
                };
            };
        };
    };

...
```

## Documentation/devicetree/bindings/media/i2c/onsemi,ar0521.yaml
```yaml
# SPDX-License-Identifier: (GPL-2.0-only OR BSD-2-Clause)
%YAML 1.2
---
$id: http://devicetree.org/schemas/media/i2c/onsemi,ar0521.yaml#
$schema: http://devicetree.org/meta-schemas/core.yaml#

title: OnSemi 1/2.5-inch 5.1Mp CMOS Digital Image Sensor

maintainers:
  - Stefan Riedmueller <s.riedmueller@phytec.de>

description: |
  The OnSemiconductor AR0521 is a 1/2.5-inch 5.1 Mp CMOS digital image sensor
  with an active-pixel array of 2592H x 1944V. It features a 2 or 4 lane
  MIPI-CSI2 interface. It is programmable through a simple two-wire serial
  interface.

properties:
  compatible:
    enum:
      - onsemi,ar0521
      - onsemi,ar0521c
      - onsemi,ar0521m

  reg:
    description: I2C device address
    maxItems: 1

  clocks:
    maxItems: 1

  clock-names:
    const: ext

  reset-gpios:
    maxItems: 1
    description: Chip reset GPIO

  port:
    $ref: /schemas/graph.yaml#/$defs/port-base
    additionalProperties: false

    properties:
      endpoint:
        $ref: /schemas/media/video-interfaces.yaml#
        unevaluatedProperties: false

        properties:
          bus-type:
            const: 4 # MIPI CSI-2 D-PHY

          onsemi,t-hs-prep:
            description: MIPI Ths_prep value
            $ref: /schemas/types.yaml#/definitions/uint32
            minimum: 0
            maximum: 15
            default: 2

          onsemi,t-hs-zero:
            description: MIPI Ths_zero value
            $ref: /schemas/types.yaml#/definitions/uint32
            minimum: 0
            maximum: 15
            default: 15

          onsemi,t-hs-trail:
            description: MIPI Ths_trail value
            $ref: /schemas/types.yaml#/definitions/uint32
            minimum: 0
            maximum: 15
            default: 9

          onsemi,t-clk-prep:
            description: MIPI Tclk_prep value
            $ref: /schemas/types.yaml#/definitions/uint32
            minimum: 0
            maximum: 15
            default: 2

          onsemi,t-clk-zero:
            description: MIPI Tclk_zero value
            $ref: /schemas/types.yaml#/definitions/uint32
            minimum: 0
            maximum: 63
            default: 34

          onsemi,t-clk-trail:
            description: MIPI Tclk_trail value
            $ref: /schemas/types.yaml#/definitions/uint32
            minimum: 0
            maximum: 15
            default: 10

          onsemi,t-bgap:
            description: MIPI Tbgap value
            $ref: /schemas/types.yaml#/definitions/uint32
            minimum: 0
            maximum: 15
            default: 10

          onsemi,t-clk-pre:
            description: MIPI Tclk_pre value
            $ref: /schemas/types.yaml#/definitions/uint32
            minimum: 0
            maximum: 63
            default: 1

          onsemi,t-clk-post-msbs:
            description: MIPI Tclk_post_msbs value
            $ref: /schemas/types.yaml#/definitions/uint32
            minimum: 0
            maximum: 15
            default: 3

          onsemi,t-lpx:
            description: MIPI Tlpx value
            $ref: /schemas/types.yaml#/definitions/uint32
            minimum: 0
            maximum: 63
            default: 7

          onsemi,t-wakeup:
            description: MIPI Twakeup value
            $ref: /schemas/types.yaml#/definitions/uint32
            minimum: 0
            maximum: 127
            default: 15

          onsemi,t-clk-post:
            description: MIPI Tclk_post value
            $ref: /schemas/types.yaml#/definitions/uint32
            minimum: 0
            maximum: 3
            default: 1

          onsemi,cont-tx-clk:
            description: MIPI continuous TX clock
            type: boolean

          onsemi,vreg-mode:
            description: MIPI enable vregulator
            type: boolean

          onsemi,t-hs-exit:
            description: MIPI Ths_exit value
            $ref: /schemas/types.yaml#/definitions/uint32
            minimum: 0
            maximum: 63
            default: 13

          onsemi,t-init:
            description: MIPI Tinit value
            $ref: /schemas/types.yaml#/definitions/uint32
            minimum: 0
            maximum: 127
            default: 12

          link-frequencies:
            description: |
              Maximum link frequencies of the interface.
            maximum: 600000000
            maxItems: 1

          data-lanes:
            oneOf:
              - items:
                - const: 1
                - const: 2
              - items:
                - const: 1
                - const: 2
                - const: 3
                - const: 4

          clock-lanes: true
          clock-noncontinuous: true

        required:
          - data-lanes
          - link-frequencies

required:
  - compatible
  - reg
  - clocks
  - clock-names
  - port

additionalProperties: false

examples:
  - |
    i2c0 {
        #address-cells = <1>;
        #size-cells = <0>;

        camera@36 {
            compatible = "onsemi,ar0521";
            reg = <0x36>;
            reset-gpios = <&gpio_sensor 0 0>;

            clocks = <&sensor_clk>;
            clock-names = "ext";

            port {
                camera_1: endpoint {
                    bus-type = <4>; /* MIPI CSI-2 D-PHY */
                    link-frequencies = /bits/ 64 <500000000>;
                    data-lanes = <1 2 3 4>;
                    clock-lanes = <0>;
                    clock-noncontinuous = <1>;
                };
            };
        };
    };
...
```
